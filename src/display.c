#include "display.h"
#include "twi.h"
#include <avr/pgmspace.h>
#include <stdint.h>

#define OLED_ADDR 0x3C

static uint8_t cursor_col = 0;
static uint8_t cursor_page = 0;

static void oled_command(uint8_t cmd)
{
    twi_start();
    twi_write(OLED_ADDR << 1);
    twi_write(0x00);
    twi_write(cmd);
    twi_stop();
}

static void oled_data(uint8_t data)
{
    twi_start();
    twi_write(OLED_ADDR << 1);
    twi_write(0x40);
    twi_write(data);
    twi_stop();
}

static const uint8_t font5x7[][5] PROGMEM = {
    {0x00,0x00,0x00,0x00,0x00}, // space
    {0x00,0x00,0x5F,0x00,0x00}, // !
    {0x00,0x07,0x00,0x07,0x00}, // "
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    {0x61,0x51,0x49,0x45,0x43}, // Z
};

static void display_char(char c)
{
    if (c == '\n') {
        cursor_page++;
        cursor_col = 0;

        if (cursor_page > 7) {
            cursor_page = 0;
        }

        display_set_cursor(cursor_col, cursor_page);
        return;
    }

    // litere mici -> litere mari
    if (c >= 'a' && c <= 'z') {
        c = c - 'a' + 'A';
    }

    // daca nu mai incape pe linie, trecem jos
    if (cursor_col > 122) {
        cursor_col = 0;
        cursor_page++;

        if (cursor_page > 7) {
            cursor_page = 0;
        }

        display_set_cursor(cursor_col, cursor_page);
    }

    if (c < ' ' || c > 'Z') {
        c = ' ';
    }

    uint8_t index = c - ' ';

    for (uint8_t i = 0; i < 5; i++) {
        oled_data(pgm_read_byte(&font5x7[index][i]));
    }

    oled_data(0x00);
    cursor_col += 6;
}

void display_set_cursor(uint8_t col, uint8_t page)
{
    cursor_col = col;
    cursor_page = page;

    oled_command(0xB0 + page);
    oled_command(0x00 + (col & 0x0F));
    oled_command(0x10 + ((col >> 4) & 0x0F));
}

void display_clear(void)
{
    for (uint8_t page = 0; page < 8; page++) {
        display_set_cursor(0, page);
        for (uint8_t col = 0; col < 128; col++) {
            oled_data(0x00);
        }
    }

    display_set_cursor(0, 0);
}

void display_print(const char *str)
{
    while (*str) {
        display_char(*str++);
    }
}

void display_init(void)
{
    oled_command(0xAE);
    oled_command(0x20);
    oled_command(0x02);
    oled_command(0xB0);
    oled_command(0xC8);
    oled_command(0x00);
    oled_command(0x10);
    oled_command(0x40);
    oled_command(0x81);
    oled_command(0x7F);
    oled_command(0xA1);
    oled_command(0xA6);
    oled_command(0xA8);
    oled_command(0x3F);
    oled_command(0xA4);
    oled_command(0xD3);
    oled_command(0x00);
    oled_command(0xD5);
    oled_command(0x80);
    oled_command(0xD9);
    oled_command(0xF1);
    oled_command(0xDA);
    oled_command(0x12);
    oled_command(0xDB);
    oled_command(0x40);
    oled_command(0x8D);
    oled_command(0x14);
    oled_command(0xAF);

    display_clear();
}

void display_draw_bitmap_128x64(const uint8_t *bitmap)
{
    for (uint8_t page = 0; page < 8; page++) {
        display_set_cursor(0, page);

        for (uint8_t x = 0; x < 128; x++) {
            uint8_t data = 0;

            for (uint8_t bit = 0; bit < 8; bit++) {
                uint8_t y = page * 8 + bit;
                uint16_t byte_index = y * 16 + (x / 8);
                uint8_t byte = pgm_read_byte(&bitmap[byte_index]);

                if (byte & (0x80 >> (x % 8))) {
                    data |= (1 << bit);
                }
            }

            oled_data(data);
        }
    }
}
